## config/west.yml
```yaml
manifest:
  remotes:
    - name: zmkfirmware
      url-base: https://github.com/zmkfirmware
    - name: LoRNiKoN
      url-base: https://github.com/LoRNiKoN
  projects:
    - name: zmk
      remote: zmkfirmware
      revision: main
      import: app/west.yml
    - name: prospector-zmk-module
      remote: LoRNiKoN
      revision: main
  self:
    path: config
```
